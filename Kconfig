## Kconfig
```kconfig
# Copyright (c) 2024 Analog Devices, Inc.
# Copyright (c) 2026 Oresat (Portland State University)
# SPDX-License-Identifier: Apache-2.0

# zephyr-keep-sorted-start
rsource "icm42688/Kconfig"
# zephyr-keep-sorted-stop
```

## dts/bindings/oresat,icm42688-i2c.yaml
```yaml
# Copyright (c) 2026 Portland State University Oresat Team
# # SPDX-License-Identifier: MIT

description: |
    Example:
    #include <zephyr/dt-bindings/sensor/icm42688.h>
    
    . . . Note that the above include is for a Zephyr in-tree header and not
    a custom Oresat header of the modified ICM42688 driver.

compatible: "oresat,icm42688"

include: ["i2c-device.yaml", "oresat,icm42688-common.yaml"]
```

## dts/bindings/oresat,icm42688-spi.yaml
```yaml
# Copyright (c) Portland State University Oresat Team
# SPDX-License-Identifier: 
#
description: |

    Example:
    #include <zephyr/dt-bindings/sensor/icm42688.h>

    &spi0 {
      ...
    };

compatible: "oresat,icm42688"

include: ["spi-device.yaml", "oresat,icm42688-common.yaml"]
```
